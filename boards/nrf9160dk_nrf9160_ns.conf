## boards/nrf9160dk_nrf9160_ns.conf
```kconfig
## nRF9160DK-specific config settings ##
# App LwM2M
CONFIG_APP_GNSS=n
CONFIG_APP_WATER_METER=y     


# Sensor module
CONFIG_SENSOR_MODULE=n

# External flash
CONFIG_SPI=y
CONFIG_SPI_NOR=y
CONFIG_STREAM_FLASH=y
CONFIG_STREAM_FLASH_ERASE=y
CONFIG_FLASH=y

# Modem library
CONFIG_NRF_MODEM_LIB_SYS_INIT=n

# Full modem update
CONFIG_DFU_TARGET_FULL_MODEM=y
CONFIG_FMFU_FDEV=y
CONFIG_ZCBOR=y
CONFIG_MODEM_INFO=y
CONFIG_FMFU_FDEV_SKIP_PREVALIDATION=n

# Crypto
CONFIG_OBERON_BACKEND=y
CONFIG_NORDIC_SECURITY_BACKEND=y
# Disable all non-used crypto
CONFIG_MBEDTLS_CHACHA20_C=n
CONFIG_MBEDTLS_POLY1305_C=n
CONFIG_MBEDTLS_ECP_C=n
CONFIG_MBEDTLS_RSA_C=n
CONFIG_MBEDTLS_DHM_C=n
CONFIG_MBEDTLS_SHA1_C=n
CONFIG_MBEDTLS_SHA384_C=n
CONFIG_MBEDTLS_SHA512_C=n
# This is the one we need
CONFIG_MBEDTLS_SHA256_C=y
```

## src/custom_objects/Kconfig.ucifi_water_meter
```kconfig
#
# Copyright (c) 2021 Nordic Semiconductor ASA
#
# SPDX-License-Identifier: LicenseRef-Nordic-5-Clause
#

config LWM2M_UCIFI_APP_WATER_METER
	bool
	help
	  The uCIFI water meter measures water volume that was distributed through a water meter, in pulse count as well as in m3. It also detects anomalies in the water meter.

if LWM2M_UCIFI_APP_WATER_METER

config MIN_LEAK_DETECTION_INTERVAL_MS
	int
	default 5000
	help
	  Water flow overspeed alert threshold time.

config MAX_LEAK_DETECTION_INTERVAL_MS
	int
	default 9000
	help
	  Water leak detection alert threshold time.

endif # LWM2M_UCIFI_APP_WATER_METER
```

## src/lwm2m/Kconfig
```kconfig
#
# Copyright (c) 2021 Nordic Semiconductor ASA
#
# SPDX-License-Identifier: LicenseRef-Nordic-5-Clause
#
config LWM2M_APP_WATER_METER
	bool
	depends on LWM2M_UCIFI_APP_WATER_METER
	help
	  Create LWM2M water meter objects.
	  It uses the UCIFI water metert object.
```
